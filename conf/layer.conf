## conf/layer.conf
```bitbake
# We have a conf and classes directory, add to BBPATH
BBPATH .= ":${LAYERDIR}"

# We have a packages directory, add to BBFILES
BBFILES += "${LAYERDIR}/recipes-*/*/*.bb \
            ${LAYERDIR}/recipes-*/*/*.bbappend"

BBFILE_COLLECTIONS += "tq2440-demos"
BBFILE_PATTERN_tq2440-demos := "^${LAYERDIR}/"
BBFILE_PRIORITY_tq2440-demos = "4"
```
